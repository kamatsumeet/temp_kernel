## kernel/kernel-4.4/Documentation/devicetree/bindings/video/nvidia,imx274.txt
```
NVIDIA Camera sensor imx274 driver interface.

Properties:
- compatible : The driver is compatible with
	"nvidia,imx274".

- reg : Should contain I2C slave address of the driver.

- reset-gpios : imx274 reset GPIO

Example:

	imx274@1a {
		compatible = "nvidia,imx274";
		reg = <0x1a>;
		/* gpio PBB3 */
		reset-gpios = <&gpio 219 0>;
		status = "okay";
	};
```
